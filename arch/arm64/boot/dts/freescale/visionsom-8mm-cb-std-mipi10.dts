// SPDX-License-Identifier: GPL-2.0-or-later
/*
 * Copyright 2020 SomLabs
 *
 */

#include "visionsom-8mm-cb-std-mipi.dtsi"
#include "visionsom-8mm-cb-ph128800t004.dtsi"

/ {
    model = "SoMLabs VisionSOM i.MX8MM CB-STD/MIPI10";
};
