// SPDX-License-Identifier: GPL-2.0-or-later
/*
 * Copyright (C) 2021 SoMLabs
 */

#include "starsom-6ull-emmc.dtsi"
#include "starsom-cb-6ull.dtsi"

/ {
        model = "SoMLabs StarSOM-CB-6ULL-EMMC";
};
